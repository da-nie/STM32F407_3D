#include "spfd5408.h"

//++++++++++++++++++++++++++++++++++++++++++++++++++++++++++++++++++++++++++++++++++++++++++++++++++++
//макроопределения
//++++++++++++++++++++++++++++++++++++++++++++++++++++++++++++++++++++++++++++++++++++++++++++++++++++

//контакты дисплея
#define SPFD5408_GPIO_PIN_CS		GPIO_PIN_12
#define SPFD5408_GPIO_CS				GPIOE

#define SPFD5408_GPIO_PIN_RST	GPIO_PIN_2
#define SPFD5408_GPIO_RST			GPIOE

#define SPFD5408_GPIO_PIN_RS		GPIO_PIN_15
#define SPFD5408_GPIO_RS				GPIOE

#define SPFD5408_GPIO_PIN_WR		GPIO_PIN_14
#define SPFD5408_GPIO_WR				GPIOE

#define SPFD5408_GPIO_PIN_RD		GPIO_PIN_13
#define SPFD5408_GPIO_RD				GPIOE


#define SPFD5408_GPIO_PIN_D0		GPIO_PIN_4
#define SPFD5408_GPIO_D0				GPIOE

#define SPFD5408_GPIO_PIN_D1		GPIO_PIN_5
#define SPFD5408_GPIO_D1				GPIOE

#define SPFD5408_GPIO_PIN_D2		GPIO_PIN_6
#define SPFD5408_GPIO_D2				GPIOE

#define SPFD5408_GPIO_PIN_D3		GPIO_PIN_7
#define SPFD5408_GPIO_D3				GPIOE

#define SPFD5408_GPIO_PIN_D4		GPIO_PIN_8
#define SPFD5408_GPIO_D4				GPIOE

#define SPFD5408_GPIO_PIN_D5		GPIO_PIN_9
#define SPFD5408_GPIO_D5				GPIOE

#define SPFD5408_GPIO_PIN_D6		GPIO_PIN_10
#define SPFD5408_GPIO_D6				GPIOE

#define SPFD5408_GPIO_PIN_D7		GPIO_PIN_11
#define SPFD5408_GPIO_D7				GPIOE

//код команды паузы в миллисекундах
#define DELAY_CODE 0xFFFF

#define TFTLCD_DELAY DELAY_CODE

#define ILI9341_SOFTRESET          0x01
#define ILI9341_SLEEPIN            0x10
#define ILI9341_SLEEPOUT           0x11
#define ILI9341_NORMALDISP         0x13
#define ILI9341_INVERTOFF          0x20
#define ILI9341_INVERTON           0x21
#define ILI9341_GAMMASET           0x26
#define ILI9341_DISPLAYOFF         0x28
#define ILI9341_DISPLAYON          0x29
#define ILI9341_COLADDRSET         0x2A
#define ILI9341_PAGEADDRSET        0x2B
#define ILI9341_MEMORYWRITE        0x2C
#define ILI9341_PIXELFORMAT        0x3A
#define ILI9341_FRAMECONTROL       0xB1
#define ILI9341_DISPLAYFUNC        0xB6
#define ILI9341_ENTRYMODE          0xB7
#define ILI9341_POWERCONTROL1      0xC0
#define ILI9341_POWERCONTROL2      0xC1
#define ILI9341_VCOMCONTROL1       0xC5
#define ILI9341_VCOMCONTROL2       0xC7
#define ILI9341_MEMCONTROL         0x36
#define ILI9341_MADCTL             0x36

#define ILI9341_MADCTL_MY  0x80
#define ILI9341_MADCTL_MX  0x40
#define ILI9341_MADCTL_MV  0x20
#define ILI9341_MADCTL_ML  0x10
#define ILI9341_MADCTL_RGB 0x00
#define ILI9341_MADCTL_BGR 0x08
#define ILI9341_MADCTL_MH  0x04

#define FONT_HEIGHT 14
#define FONT_WIDTH 8

//----------------------------------------------------------------------------------------------------
//глобальные переменные
//----------------------------------------------------------------------------------------------------

volatile static long PrintYPosition=0;//позиция вывода строки

const unsigned char Font8x14[224][14]=
{
 { 0x00, 0x00, 0x00, 0x00, 0x00, 0x00, 0x00, 0x00, 0x00, 0x00, 0x00, 0x00, 0x00, 0x00},//' '=0x20 
 { 0x00, 0x10, 0x38, 0x38, 0x38, 0x10, 0x10, 0x10, 0x00, 0x10, 0x10, 0x00, 0x00, 0x00},//'!'=0x21 
 { 0x00, 0x66, 0x66, 0x22, 0x44, 0x00, 0x00, 0x00, 0x00, 0x00, 0x00, 0x00, 0x00, 0x00},//'"'=0x22 
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 { 0x00, 0x00, 0x00, 0x00, 0x7E, 0xCC, 0xCC, 0xFC, 0x6C, 0xCC, 0xCE, 0x00, 0x00, 0x00}
};

//++++++++++++++++++++++++++++++++++++++++++++++++++++++++++++++++++++++++++++++++++++++++++++++++++++
//++++++++++++++++++++++++++++++++++++++++++++++++++++++++++++++++++++++++++++++++++++++++++++++++++++
//общие функции
//++++++++++++++++++++++++++++++++++++++++++++++++++++++++++++++++++++++++++++++++++++++++++++++++++++
//++++++++++++++++++++++++++++++++++++++++++++++++++++++++++++++++++++++++++++++++++++++++++++++++++++

//----------------------------------------------------------------------------------------------------
//инициализация LCD-экрана
//----------------------------------------------------------------------------------------------------
void SPFD5408_Init(void)
{
 //настраиваем порты

 __HAL_RCC_GPIOD_CLK_ENABLE();
 __HAL_RCC_GPIOE_CLK_ENABLE();
	
 //GPIO_Pin – номера выводов, которые конфигурируются. Пример для нескольких выводов:
 //GPIO_InitStructure.GPIO_Pin = GPIO_Pin_0 | GPIO_Pin_1 | GPIO_Pin_2;
 //GPIO_Speed – задает скорость для выбранных выводов.
 //GPIO_Mode – задает режим работы выводов. 

 //настраиваем параметры портов
 GPIO_InitTypeDef SPFD5408_GPIO_Init;

 SPFD5408_GPIO_Init.Mode=GPIO_MODE_OUTPUT_PP;
 SPFD5408_GPIO_Init.Pull=GPIO_NOPULL;
 SPFD5408_GPIO_Init.Speed=GPIO_SPEED_FREQ_VERY_HIGH;


 SPFD5408_GPIO_Init.Pin=SPFD5408_GPIO_PIN_CS;
 HAL_GPIO_Init(SPFD5408_GPIO_CS,&SPFD5408_GPIO_Init);

 SPFD5408_GPIO_Init.Pin=SPFD5408_GPIO_PIN_RS;
 HAL_GPIO_Init(SPFD5408_GPIO_RS,&SPFD5408_GPIO_Init);

 SPFD5408_GPIO_Init.Pin=SPFD5408_GPIO_PIN_RST;
 HAL_GPIO_Init(SPFD5408_GPIO_RST,&SPFD5408_GPIO_Init);

 SPFD5408_GPIO_Init.Pin=SPFD5408_GPIO_PIN_RD;
 HAL_GPIO_Init(SPFD5408_GPIO_RD,&SPFD5408_GPIO_Init);

 SPFD5408_GPIO_Init.Pin=SPFD5408_GPIO_PIN_WR;
 HAL_GPIO_Init(SPFD5408_GPIO_WR,&SPFD5408_GPIO_Init);
 

 SPFD5408_GPIO_Init.Pin=SPFD5408_GPIO_PIN_D0;
 HAL_GPIO_Init(SPFD5408_GPIO_D0,&SPFD5408_GPIO_Init);

 SPFD5408_GPIO_Init.Pin=SPFD5408_GPIO_PIN_D1;
 HAL_GPIO_Init(SPFD5408_GPIO_D1,&SPFD5408_GPIO_Init);

 SPFD5408_GPIO_Init.Pin=SPFD5408_GPIO_PIN_D2;
 HAL_GPIO_Init(SPFD5408_GPIO_D2,&SPFD5408_GPIO_Init);

 SPFD5408_GPIO_Init.Pin=SPFD5408_GPIO_PIN_D3;
 HAL_GPIO_Init(SPFD5408_GPIO_D3,&SPFD5408_GPIO_Init);

 SPFD5408_GPIO_Init.Pin=SPFD5408_GPIO_PIN_D4;
 HAL_GPIO_Init(SPFD5408_GPIO_D4,&SPFD5408_GPIO_Init);

 SPFD5408_GPIO_Init.Pin=SPFD5408_GPIO_PIN_D5;
 HAL_GPIO_Init(SPFD5408_GPIO_D5,&SPFD5408_GPIO_Init);

 SPFD5408_GPIO_Init.Pin=SPFD5408_GPIO_PIN_D6;
 HAL_GPIO_Init(SPFD5408_GPIO_D6,&SPFD5408_GPIO_Init);

 SPFD5408_GPIO_Init.Pin=SPFD5408_GPIO_PIN_D7;
 HAL_GPIO_Init(SPFD5408_GPIO_D7,&SPFD5408_GPIO_Init);

 //инициализируем дисплей
 SPFD5408_Reset();
 SPFD5408_CS_Zero();
 
 SPFD5408_WriteRegister8(ILI9341_SOFTRESET,0);
 HAL_Delay(50);
 SPFD5408_WriteRegister8(ILI9341_DISPLAYOFF,0);
 SPFD5408_WriteRegister8(ILI9341_POWERCONTROL1,0x23);
 SPFD5408_WriteRegister8(ILI9341_POWERCONTROL2,0x10);
 SPFD5408_WriteRegister16(ILI9341_VCOMCONTROL1,0x2B2B);
 SPFD5408_WriteRegister8(ILI9341_VCOMCONTROL2,0xC0);
 SPFD5408_WriteRegister8(ILI9341_MEMCONTROL,ILI9341_MADCTL_MY|ILI9341_MADCTL_BGR);
 SPFD5408_WriteRegister8(ILI9341_PIXELFORMAT,0x55);
 SPFD5408_WriteRegister16(ILI9341_FRAMECONTROL,0x001B);    
 SPFD5408_WriteRegister8(ILI9341_ENTRYMODE,0x07);
 SPFD5408_WriteRegister8(ILI9341_SLEEPOUT,0);
 HAL_Delay(150);
 SPFD5408_WriteRegister8(ILI9341_DISPLAYON,0);
 HAL_Delay(500);
}
//----------------------------------------------------------------------------------------------------
//выставить на CS 1
//----------------------------------------------------------------------------------------------------
inline void SPFD5408_CS_One(void)
{
 HAL_GPIO_WritePin(SPFD5408_GPIO_CS,SPFD5408_GPIO_PIN_CS,GPIO_PIN_SET);
}
//----------------------------------------------------------------------------------------------------
//выставить на CS 0
//----------------------------------------------------------------------------------------------------
inline void SPFD5408_CS_Zero(void)
{
 HAL_GPIO_WritePin(SPFD5408_GPIO_CS,SPFD5408_GPIO_PIN_CS,GPIO_PIN_RESET);
}
//----------------------------------------------------------------------------------------------------
//выставить на RS 1
//----------------------------------------------------------------------------------------------------
inline void SPFD5408_RS_One(void)
{
 HAL_GPIO_WritePin(SPFD5408_GPIO_RS,SPFD5408_GPIO_PIN_RS,GPIO_PIN_SET);
}
//----------------------------------------------------------------------------------------------------
//выставить на RS 0
//----------------------------------------------------------------------------------------------------
inline void SPFD5408_RS_Zero(void)
{
  HAL_GPIO_WritePin(SPFD5408_GPIO_RS,SPFD5408_GPIO_PIN_RS,GPIO_PIN_RESET);
}
//----------------------------------------------------------------------------------------------------
//выставить на WR 1
//----------------------------------------------------------------------------------------------------
inline void SPFD5408_WR_One(void)
{
 HAL_GPIO_WritePin(SPFD5408_GPIO_WR,SPFD5408_GPIO_PIN_WR,GPIO_PIN_SET);
}
//----------------------------------------------------------------------------------------------------
//выставить на WR 0
//----------------------------------------------------------------------------------------------------
inline void SPFD5408_WR_Zero(void)
{
 HAL_GPIO_WritePin(SPFD5408_GPIO_WR,SPFD5408_GPIO_PIN_WR,GPIO_PIN_RESET);
}
//----------------------------------------------------------------------------------------------------
//выставить на RST 1
//----------------------------------------------------------------------------------------------------
inline void SPFD5408_RST_One(void)
{
 HAL_GPIO_WritePin(SPFD5408_GPIO_RST,SPFD5408_GPIO_PIN_RST,GPIO_PIN_SET);
}
//----------------------------------------------------------------------------------------------------
//выставить на RST 0
//----------------------------------------------------------------------------------------------------
inline void SPFD5408_RST_Zero(void)
{
 HAL_GPIO_WritePin(SPFD5408_GPIO_RST,SPFD5408_GPIO_PIN_RST,GPIO_PIN_RESET);
}
//----------------------------------------------------------------------------------------------------
//выставить на RD 1
//----------------------------------------------------------------------------------------------------
inline void SPFD5408_RD_One(void)
{
 HAL_GPIO_WritePin(SPFD5408_GPIO_RD,SPFD5408_GPIO_PIN_RD,GPIO_PIN_SET);
}
//----------------------------------------------------------------------------------------------------
//выставить на RD 0
//----------------------------------------------------------------------------------------------------
inline void SPFD5408_RD_Zero(void)
{
 HAL_GPIO_WritePin(SPFD5408_GPIO_RD,SPFD5408_GPIO_PIN_RD,GPIO_PIN_RESET);
}
//----------------------------------------------------------------------------------------------------
//задать значение на шине данных
//----------------------------------------------------------------------------------------------------
inline void SPFD5408_SetData(unsigned char byte)
{
 unsigned long inv_byte=0xFF^byte;
 unsigned long pr_byte=byte;
 SPFD5408_GPIO_D0->BSRR=(pr_byte<<4UL)|(inv_byte<<(4UL+16UL));

}

//----------------------------------------------------------------------------------------------------
//выполнить сброс
//----------------------------------------------------------------------------------------------------
void SPFD5408_Reset(void)
{
 SPFD5408_CS_One();
 SPFD5408_RS_One();
 SPFD5408_RD_One();
 SPFD5408_WR_One();
 SPFD5408_RST_One();    
 HAL_Delay(10);
 SPFD5408_RST_Zero();
 HAL_Delay(10);
 SPFD5408_RST_One();
 HAL_Delay(250);
}
//----------------------------------------------------------------------------------------------------
//передать байт
//----------------------------------------------------------------------------------------------------
inline void SPFD5408_Write8(unsigned char byte)
{ 
 SPFD5408_SetData(byte);
 SPFD5408_WR_Zero();
 SPFD5408_WR_One();
}
//----------------------------------------------------------------------------------------------------
//передать 16 бит 
//----------------------------------------------------------------------------------------------------
inline void SPFD5408_Write16(unsigned short value) 
{ 
 SPFD5408_Write8((value>>8)&0xFF);
 SPFD5408_Write8(value&0xFF);
}
//----------------------------------------------------------------------------------------------------
//передать 24 бита
//----------------------------------------------------------------------------------------------------
inline void SPFD5408_Write24(unsigned long value) 
{ 
 SPFD5408_Write8((value>>16)&0xFF);
 SPFD5408_Write8((value>>8)&0xFF);
 SPFD5408_Write8(value&0xFF);
}
//----------------------------------------------------------------------------------------------------
//передать 32 бита
//----------------------------------------------------------------------------------------------------
inline void SPFD5408_Write32(unsigned long value) 
{ 
 SPFD5408_Write8((value>>24)&0xFF);
 SPFD5408_Write8((value>>16)&0xFF);
 SPFD5408_Write8((value>>8)&0xFF);
 SPFD5408_Write8(value&0xFF);
}
//----------------------------------------------------------------------------------------------------
//записать в регистр 16 бит
//----------------------------------------------------------------------------------------------------
inline void SPFD5408_WriteRegister16(unsigned short reg,unsigned short value) 
{ 
 SPFD5408_RS_Zero();
 SPFD5408_Write16(reg);
 SPFD5408_RS_One();
 SPFD5408_Write16(value); 
}
//----------------------------------------------------------------------------------------------------
//записать в регистр 8 бит
//----------------------------------------------------------------------------------------------------
inline void SPFD5408_WriteRegister8(unsigned char reg,unsigned char value) 
{ 
 SPFD5408_RS_Zero();
 SPFD5408_Write8(reg);
 SPFD5408_RS_One();
 SPFD5408_Write8(value); 
}

//----------------------------------------------------------------------------------------------------
//задать окно
//----------------------------------------------------------------------------------------------------
void SPFD5408_SetWindow(unsigned short x_left,unsigned short y_top,unsigned short x_right,unsigned short y_bottom)
{
 SPFD5408_RS_Zero();
 SPFD5408_Write8(ILI9341_COLADDRSET);
 SPFD5408_RS_One();
 SPFD5408_Write16(x_left);	
 SPFD5408_Write16(x_right);	

 SPFD5408_RS_Zero();
 SPFD5408_Write8(ILI9341_PAGEADDRSET);
 SPFD5408_RS_One();
 SPFD5408_Write16(y_top);	
 SPFD5408_Write16(y_bottom);	

 SPFD5408_RS_Zero();
 SPFD5408_Write8(ILI9341_MEMORYWRITE);
 SPFD5408_RS_One();	
}
//------------------------------------------------------------------------------
//передать цвет точки
//------------------------------------------------------------------------------
void SPFD5408_OutColor(unsigned short color)
{
 SPFD5408_Write16(color);
}
//------------------------------------------------------------------------------
//вывести один пиксель
//------------------------------------------------------------------------------
void SPFD5408_PutPixel(unsigned short x, unsigned short y, unsigned short color)
{
 SPFD5408_SetWindow(x,y,x,y);
 SPFD5408_OutColor(color);
}

//----------------------------------------------------------------------------------------------------
//вывод символа в позицию
//----------------------------------------------------------------------------------------------------
void SPFD5408_PutSymbol(long x,long y,char symbol,unsigned short color)
{
 unsigned char s=(unsigned char)(symbol);
 if (s<=32) return;
 s-=32;
 if (s>223) return;
 //рисуем символ
 for(long ys=0;ys<FONT_HEIGHT;ys++)
 {
  unsigned char byte=Font8x14[s][ys];
  unsigned char mask=128;
  for(long xs=0;xs<FONT_WIDTH;xs++,mask>>=1)
  {   
   if (x+xs<0 || x+xs>=SPFD5408_WIDTH) continue;
   if (y+ys<0 || y+ys>=SPFD5408_HEIGHT) continue;
   if (byte&mask) SPFD5408_PutPixel(x+xs,y+ys,color);
  }
 }	
}
//----------------------------------------------------------------------------------------------------
//вывод строчки в позицию
//----------------------------------------------------------------------------------------------------
void SPFD5408_PutString(long x,long y,const char *string,unsigned short color)
{
 long s=0;	
 while((*string)!=0)
 {
  SPFD5408_PutSymbol(x,y,*string,color);
	x+=FONT_WIDTH;  
	string++;
	s++;
	if (s>20) break;
 }	
}
//----------------------------------------------------------------------------------------------------
//вывести текст в текущую позицию
//----------------------------------------------------------------------------------------------------
void SPFD5408_Print(const char *string,unsigned short color)
{
 if (PrintYPosition+FONT_HEIGHT>=SPFD5408_HEIGHT) SPFD5408_Clear();
 SPFD5408_PutString(0,PrintYPosition,string,color);
 PrintYPosition+=FONT_HEIGHT;	
}
//----------------------------------------------------------------------------------------------------
//сбросить текущую позицию
//----------------------------------------------------------------------------------------------------
void SPFD5408_Clear(void)
{
 PrintYPosition=0;	
 SPFD5408_SetWindow(0,0,SPFD5408_WIDTH-1,SPFD5408_HEIGHT-1);
 //выбираем регистр вывода изображения
 SPFD5408_RS_Zero();
 SPFD5408_Write8(ILI9341_MEMORYWRITE);
 //передаём данные картинки
 SPFD5408_RS_One();
 for(long y=0;y<SPFD5408_HEIGHT;y++)
 {
  for(long x=0;x<SPFD5408_WIDTH;x++)
  {
		SPFD5408_Write16(SPFD5408_BLACK);
  }
 }
}












